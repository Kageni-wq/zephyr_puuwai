/* Copyright (c) 2025 Alif Semiconductor
 *
 * SPDX-License-Identifier: Apache-2.0
 */

#include "alif/vendor/ensemble/common/e4_e6_e8.dtsi"
#include "alif/vendor/ensemble/common/aipm_ensemble_gen2.dtsi"

&sram0 {
	reg = <0x02000000 DT_SIZE_K(4096)>;
};

&mram_flash {
	reg = <0x80000000 DT_SIZE_K(5632)>;
};

&mram_storage {
	reg = <0x80000000 DT_SIZE_K(5632)>;
};
