## Kconfig.puuwai
```kconfig
# Copyright (c) 2026 Kagen Aeby
# SPDX-License-Identifier: Apache-2.0

menu "Puuwai hardware-module integration"

comment "The implementations live in the Puuwai hardware module, which sets these"

config PUUWAI_PANEL_HOOKS
	bool "GC9x01x lifecycle owned by the Puuwai panel owner"
	depends on GC9X01X
	help
	  The GC9x01x driver delegates device PM to puuwai_panel_pm_action() and
	  exports its reset, sleep and wake operations, so one owner can sequence
	  panel rails, controller registers and touch. Without this the driver
	  keeps its own suspend/resume behavior.

config PUUWAI_SD_HOST_HOOKS
	bool "SDMMC controller admission owned by the Puuwai SD host"
	depends on SDHC_STM32_SDMMC
	help
	  The STM32 SDHC driver admits requests only while the Puuwai SD host has
	  power and clocks established, and the SDMMC disk exposes a reference
	  counted deinitialization for that owner. Without this the drivers behave
	  as upstream.

config PUUWAI_IW612_COLD_LIFECYCLE
	bool "IW612 Wi-Fi cold start and stop owned by the Puuwai radio bridge"
	depends on WIFI_NXP
	help
	  The NXP Wi-Fi driver defers WLAN initialization to the platform bridge
	  that owns the shared IW612 rails and PWDN, instead of resetting the
	  module itself during net_if initialization. It then requires the cold
	  lifecycle helpers the hardware module supplies.

endmenu
```

## drivers/clock_control/Kconfig.alif_sdk
```kconfig
# Copyright (c) 2025 Alif Semiconductor
#
# SPDX-License-Identifier: Apache-2.0

config CLOCK_CONTROL_ALIF_SDK
	bool "Alif clock control driver"
	default y
	depends on DT_HAS_ALIF_CLOCKCTRL_SDK_ENABLED
	help
	  Enable Alif clock control driver.
```

## drivers/crc/Kconfig.alif
```kconfig
# Alif CRC driver configuration options

# Copyright (C) 2024 Alif Semiconductor
# SPDX-License-Identifier: Apache-2.0

config CRC_ALIF
	bool "Alif CRC driver"
	default y
	depends on ALIF_VENDOR && DT_HAS_ALIF_ALIF_CRC_ENABLED
	select CRC_DRIVER_HAS_CRC8
	select CRC_DRIVER_HAS_CRC8_CCITT
	select CRC_DRIVER_HAS_CRC16
	select CRC_DRIVER_HAS_CRC16_REFLECT
	select CRC_DRIVER_HAS_CRC16_ANSI
	select CRC_DRIVER_HAS_CRC16_CCITT
	select CRC_DRIVER_HAS_CRC16_ITU_T
	select CRC_DRIVER_HAS_CRC32_C
	select CRC_DRIVER_HAS_CRC32_IEEE
	select CRC_DRIVER_HAS_CRC32_MPEG2
	help
	  Enable driver for Alif CRC
```

## drivers/dac/Kconfig.alif
```kconfig
# Copyright (C) 2025 Alif Semiconductor
# SPDX-License-Identifier: Apache-2.0

config DAC_ALIF
	bool "Alif DAC driver"
	select USE_ALIF_HAL_ANALOG
	default y
	depends on DT_HAS_ALIF_DAC_ENABLED
	help
	  Enable DAC module for Alif Boards
```

## drivers/display/Kconfig.ili9488_alif
```kconfig
# SPDX-FileCopyrightText: Copyright The Zephyr Project Contributors
# SPDX-License-Identifier: Apache-2.0

config ILI9488_ALIF
	bool "ILI9488 panel on Alif DBI or DSI"
	default y
	depends on ALIF_VENDOR && DT_HAS_ILITEK_ILI9488_ALIF_ENABLED
	select MIPI_DBI if $(dt_compat_on_bus,$(DT_COMPAT_ILITEK_ILI9488_ALIF),mipi-dbi)
	select MIPI_DSI if $(dt_compat_on_bus,$(DT_COMPAT_ILITEK_ILI9488_ALIF),mipi-dsi)
```

## drivers/ethernet/alif/Kconfig
```kconfig
# SPDX-FileCopyrightText: Copyright The Zephyr Project Contributors
# SPDX-License-Identifier: Apache-2.0

config ETH_DWMAC_ALIF
	bool "Alif Ensemble DesignWare Ethernet MAC"
	default y
	depends on ETH_DRIVER && ALIF_VENDOR && DT_HAS_ALIF_ETHERNET_ENABLED
	depends on NET_BUF_FIXED_DATA_SIZE
	select PINCTRL
	select CLOCK_CONTROL
	select MDIO
	select ETH_PHY_DRIVER

if ETH_DWMAC_ALIF

config ETH_DWMAC_PASS_ALL_MULTICAST
	bool "Pass all multicast frames"

config ALIF_DWMAC_NB_TX_DESCS
	int "Transmit descriptor count"
	default 16
	range 4 128

config ALIF_DWMAC_NB_RX_DESCS
	int "Receive descriptor count"
	default 16
	range 4 128

endif
```

## drivers/video/Kconfig.alif
```kconfig
# Alif Camera controller driver configuration options

# Copyright (C) 2024 Alif Semiconductor
# SPDX-License-Identifier: Apache-2.0

config VIDEO_ALIF_CAM
	bool "Camera Parallel Interface (CPI) controller driver"
	default y
	depends on DT_HAS_ALIF_CAM_ENABLED

if VIDEO_ALIF_CAM

config VIDEO_ALIF_CAM_INIT_PRIORITY
	int "CPI Video initialization priority"
	default 59
	help
	 System initialization priority for Alif Camera Driver.
	 The default initialization priority for video devices is 60.

config VIDEO_ALIF_CAM_EXTENDED
	bool "CPI has extended registers and Ports."
	help
	 CPI has extended registers and ports to forward video
	 signals to ISP and dump the frame to memory.

endif #VIDEO_ALIF_CAM

config VIDEO_HM0360_ALIF
	bool "Alif HM0360 camera support"
	default y
	depends on ALIF_VENDOR && DT_HAS_HIMAX_HM0360_ALIF_ENABLED
	select I2C

config VIDEO_MT9M114_ALIF
	bool "Alif MT9M114 camera support"
	default y
	depends on ALIF_VENDOR && DT_HAS_APTINA_MT9M114_ALIF_ENABLED
	select I2C

config MT9M114_ALIF_PARALLEL_INIT
	bool "MT9M114 parallel interface initialization"
	depends on VIDEO_MT9M114_ALIF
	default y
```

## soc/alif/vendor/ensemble/Kconfig.defconfig
```kconfig
if ALIF_VENDOR

choice ETHOS_U_NPU_CONFIG
	default ETHOS_U55_256 if RTSS_HP
endchoice

# Copyright (c) 2025 Alif Semiconductor
#
# SPDX-License-Identifier: Apache-2.0

if SOC_FAMILY_ENSEMBLE
rsource "*/Kconfig.defconfig"
endif # SOC_FAMILY_ENSEMBLE

config SDHC_DESCRIPTOR_SECTION
	string "Alif Non Secure Section Name for SDHC Descriptor"
	default ".alif_ns" if $(dt_nodelabel_enabled,ns)

config SDHC_DWC_DMA_ADDR_TRANSLATE
	default y

config I2C_DW_IC_CLK_FREQ_OPTIMIZATION
	default y if I2C_DW

endif # ALIF_VENDOR
```
